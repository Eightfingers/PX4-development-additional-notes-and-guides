## examples/example_hellosky/Kconfig
```kconfig
menuconfig EXAMPLES_EXAMPLE_HELLOSKY
	bool "example_hellosky"
	default n
	---help---
		Enable support for example_hellosky
```

## examples/example_simple_publish/Kconfig
```kconfig
menuconfig EXAMPLES_EXAMPLE_SIMPLE_PUBLISH
	bool "example_simple_publish"
	default n
	---help---
		Enable support for example_simple_publish
```

## examples/example_simple_subscribe/Kconfig
```kconfig
menuconfig EXAMPLES_EXAMPLE_SIMPLE_SUBSCRIBE
	bool "example_simple_subscribe"
	default n
	---help---
		Enable support for example_simple_subscribe
```

## examples/example_wq_accel_subscribe/Kconfig
```kconfig
menuconfig EXAMPLES_EXAMPLE_WQ_ACCEL_SUBSCRIBE
	bool "example_wq_accel_subscribe"
	default n
	---help---
		Enable support for example_wq_accel_subscribe
```

## examples/example_wq_mavlog_publish/Kconfig
```kconfig
menuconfig EXAMPLES_EXAMPLE_WQ_MAVLOG_PUBLISH
	bool "example_wq_mavlog_publish"
	default n
	---help---
		Enable support for example_wq_mavlog_publish
```
